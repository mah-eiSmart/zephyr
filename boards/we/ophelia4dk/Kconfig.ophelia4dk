## boards/we/ophelia4dk/Kconfig.ophelia4dk
```kconfig
# Copyright (c) 2026 Würth Elektronik eiSos GmbH & Co. KG
# SPDX-License-Identifier: Apache-2.0

config BOARD_OPHELIA4DK
	select SOC_NRF54L15_CPUAPP if BOARD_OPHELIA4DK_NRF54L15_CPUAPP
	select SOC_NRF54L15_CPUFLPR if BOARD_OPHELIA4DK_NRF54L15_CPUFLPR
```

## boards/we/ophelia4dk/board.yml
```yaml
board:
  name: ophelia4dk
  full_name: Ophelia-IV DK
  vendor: we
  socs:
  - name: nrf54l15
    variants:
    - name: xip
      cpucluster: cpuflpr
```
